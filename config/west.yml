## config/west.yml
```yaml
manifest:
  defaults:
    revision: v0.3
  remotes:
    - name: zmkfirmware
      url-base: https://github.com/zmkfirmware
    - name: petejohanson
      url-base: https://github.com/petejohanson/
    - name: caksoylar
      url-base: https://github.com/caksoylar
    - name: geeksville
      url-base: https://github.com/geeksville
    # Added for urob's ported keymap.
    - name: urob
      url-base: https://github.com/urob
    # Prospector scanner-mode status broadcaster (keyboard side).
    - name: t-ogura
      url-base: https://github.com/t-ogura
  projects:
    - name: zmk
      remote: zmkfirmware
      import: app/west.yml
    - name: cirque-input-module
      remote: geeksville
      revision: toucan
    - name: zmk-rgbled-widget
      remote: caksoylar
      revision: v0.3
    # urob modules used by the ported keymap, pinned to their v0.3 release tags to
    # match ZMK v0.3 (the toucan's pinned ZMK). urob's main branch targets the newer
    # ZMK v0.4 C API (e.g. zmk_keymap_layer_activate gained an argument), which does
    # NOT compile against v0.3. zmk-leader-key + zmk-unicode are intentionally
    # omitted (leader key dropped from this first pass).
    - name: zmk-helpers
      remote: urob
      revision: v0.3
      path: modules/zmk/helpers
    - name: zmk-adaptive-key
      remote: urob
      revision: v0.3
      path: modules/zmk/adaptive-key
    - name: zmk-auto-layer
      remote: urob
      revision: v0.3
      path: modules/zmk/auto-layer
    - name: zmk-tri-state
      remote: urob
      revision: v0.3
      path: modules/zmk/tri-state
    # Broadcasts keyboard status (active layer, battery) as a BLE advertisement
    # so a Prospector dongle in scanner mode can display it without pairing.
    # v2.2.1 explicitly supports ZMK v0.3 (Zephyr 3.5); enabled via the
    # CONFIG_ZMK_STATUS_* keys in boards/shields/toucan/toucan_left.conf.
    - name: prospector-zmk-module
      remote: t-ogura
      revision: v2.2.1
      path: modules/prospector-zmk-module
  self:
    path: config
```
